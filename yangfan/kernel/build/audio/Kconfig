## yangfan/kernel/build/audio/Kconfig
```kconfig
config DRIVERS_HDF_AUDIO_RK3399
    bool "Enable HDF Audio Codec driver"
    default y
    depends on DRIVERS_HDF_AUDIO
    help
        Answer Y to choice HDF Audio Codec driver.
```

## yangfan/kernel/src/driv/soc/Kconfig.cpu
```kconfig
# SPDX-License-Identifier: GPL-2.0

menu "Rockchip CPU selection"
	depends on ARCH_ROCKCHIP

config CPU_RK3399
	bool "RK3399"
endmenu
```

## zhiyuan/kernel/driver/drivers/Kconfig
```kconfig
# SPDX-License-Identifier: GPL-2.0-only

# Minimal System
menu "Device Drivers"
source "$(BSP_TOP)drivers/clk/Kconfig"
source "$(BSP_TOP)drivers/pinctrl/Kconfig"
source "$(BSP_TOP)drivers/uart/Kconfig"
source "$(BSP_TOP)drivers/timer/Kconfig"

# Basic System
source "$(BSP_TOP)drivers/dma/Kconfig"
source "$(BSP_TOP)drivers/rtc/Kconfig"
# source "$(BSP_TOP)drivers/bus/Kconfig"
source "$(BSP_TOP)drivers/dumpreg/Kconfig"
source "$(BSP_TOP)drivers/watchdog/Kconfig"
source "$(BSP_TOP)drivers/i2c/Kconfig"
source "$(BSP_TOP)drivers/spi/Kconfig"
source "$(BSP_TOP)drivers/ledc/Kconfig"
source "$(BSP_TOP)drivers/pwm/Kconfig"
# source "$(BSP_TOP)drivers/ir-tx/Kconfig"
# source "$(BSP_TOP)drivers/ir-rx/Kconfig"
source "$(BSP_TOP)drivers/gpadc/Kconfig"
source "$(BSP_TOP)drivers/lradc/Kconfig"
# source "$(BSP_TOP)drivers/rtp/Kconfig"
source "$(BSP_TOP)drivers/usb/Kconfig"
source "$(BSP_TOP)drivers/iommu/Kconfig"
source "$(BSP_TOP)drivers/gmac/Kconfig"

# Power Management
source "$(BSP_TOP)drivers/irqchip/Kconfig"
source "$(BSP_TOP)drivers/standby/Kconfig"
source "$(BSP_TOP)drivers/thermal/Kconfig"
source "$(BSP_TOP)drivers/nvmem/Kconfig"
# source "$(BSP_TOP)drivers/pm_domain/Kconfig"
source "$(BSP_TOP)drivers/power/Kconfig"
source "$(BSP_TOP)drivers/cpufreq/Kconfig"

# Input
source "$(BSP_TOP)drivers/input/Kconfig"

# Storage
source "$(BSP_TOP)drivers/mmc/Kconfig"

# Graphics
source "$(BSP_TOP)drivers/video/Kconfig"
source "$(BSP_TOP)drivers/g2d/Kconfig"
source "$(BSP_TOP)drivers/vin/Kconfig"

# Multi-Media
# source "$(BSP_TOP)drivers/ve/Kconfig"

# Sound
# source "$(BSP_TOP)drivers/sound/Kconfig"

# Security
source "$(BSP_TOP)drivers/smc/Kconfig"
source "$(BSP_TOP)drivers/sid/Kconfig"
# source "$(BSP_TOP)drivers/secure_storage/Kconfig"

# Net
source "$(BSP_TOP)drivers/net/Kconfig"

# Wireless
source "$(BSP_TOP)drivers/bluetooth/Kconfig"

# Misc
source "$(BSP_TOP)drivers/misc/Kconfig"

# Drm
source "$(BSP_TOP)drivers/drm/Kconfig"

# Open source GPU
source "$(BSP_TOP)drivers/gpu/panfrost/Kconfig"

endmenu
```

## zhiyuan/kernel/driver/drivers/clk/Kconfig
```kconfig
# SPDX-License-Identifier: GPL-2.0-only
menu "Clock Drivers"
	depends on AW_BSP

config AW_CCU
	tristate "Clock Support for Allwinner SoCs"
	depends on AW_BSP
	default y
	select RESET_CONTROLLER
	select AW_RTC_CCU

config AW_SUN8IW20_CCU
	tristate "SUN8IW20 CCU"
	default ARCH_SUN8IW20
	depends on AW_CCU

config AW_SUN8IW20_R_CCU
	tristate "SUN8IW20 PRCM CCU"
	default ARCH_SUN8IW20
	depends on AW_CCU

config AW_SUN50IW12_CCU
	tristate "SUN50IW12 CCU"
	default ARCH_SUN50IW12
	depends on AW_CCU

config AW_SUN50IW12_R_CCU
	tristate "SUN50IW12 PRCM CCU"
	default ARCH_SUN50IW12
	depends on AW_CCU

config AW_SUN50IW10_CCU
	tristate "SUN50IW10 CCU"
	default ARCH_SUN50IW10
	depends on AW_CCU

config AW_SUN50IW10_R_CCU
	tristate "SUN50IW10 PRCM CCU"
	default ARCH_SUN50IW10
	depends on AW_CCU

config AW_SUN50IW9_CCU
	tristate "SUN50IW9 CCU"
	default ARCH_SUN50IW9
	depends on AW_CCU

config AW_SUN50IW9_R_CCU
	tristate "SUN50IW9 PRCM CCU"
	default ARCH_SUN50IW9
	depends on AW_CCU

config AW_RTC_CCU
	tristate "RTC domain clocks"
	default y
	help
	  sunxi clock provider in RTC domain, which provides clocks such as
	  dcxo24M-out, iosc, osc32k, osc32k-out and rtc-1k. This module is
	  mandatory for sunxi SoCs. Say 'Y' here.

endmenu
```

## zhiyuan/kernel/driver/drivers/emac/Kconfig
```kconfig
# SPDX-License-Identifier: GPL-2.0-only
menu "Emac Drivers"
	depends on AW_BSP

config AW_EMAC
	tristate "Allwinner EMAC support"
	depends on OF
	depends on AW_EMAC_MDIO
	select CRC32
	select MII
	select PHYLIB
	help
	  Support for Allwinner Gigabit ethernet driver.

	  To compile this driver as a module, choose M here.  The module
	  will be called sunxi-emac.ko.

config AW_EMAC_MDIO
	bool "Allwinner EMAC mdio support"
	depends on OF
	select MDIO_BUS
	select MDIO_DEVICE
	select NETDEVICES
	select PHYLIB
	default y
	help
	  Support for Allwinner EMAC mdio driver

endmenu
```

## zhiyuan/kernel/driver/drivers/gmac/Kconfig
```kconfig
# SPDX-License-Identifier: GPL-2.0-only
menu "Gmac Drivers"
	depends on AW_BSP

config AW_GMAC
	tristate "Allwinner GMAC support"
	depends on OF
	select CRC32
	select MII
	select PHYLIB
	help
	  Support for Allwinner Gigabit ethernet driver.

	  To compile this driver as a module, choose M here.  The module
	  will be called sunxi-gmac.ko.

config AW_EXT_PHY
	bool "Use extern phy"
	depends on AW_GMAC
	default y
	help
	  Allwinnertech SOC support both internal & extern PHY, Say "Y" to
	  use extern phy, Say "N" to use internal phy

endmenu
```

## zhiyuan/kernel/driver/drivers/input/ctp/Kconfig
```kconfig
# SPDX-License-Identifier: GPL-2.0-only
#
# Touchscreen driver configuration
#

menuconfig AW_INPUT_CTP
	bool "Touchscreens input device support"
	help
	  Say Y here, and a list of supported touchscreens will be displayed.
	  This option doesn't affect the kernel.

	  If unsure, say Y.

if AW_INPUT_CTP

source "$(BSP_TOP)drivers/input/ctp/gslx680new/Kconfig"
source "$(BSP_TOP)drivers/input/ctp/wacom_pen/Kconfig"

endif #touch input device support
```

## zhiyuan/kernel/driver/drivers/misc/Kconfig
```kconfig
menu "Misc Devices Drivers"

source "$(BSP_TOP)drivers/misc/sunxi-rf/Kconfig"
source "$(BSP_TOP)drivers/misc/sunxi-addr/Kconfig"

endmenu
```

## zhiyuan/kernel/driver/drivers/misc/sunxi-addr/Kconfig
```kconfig
config AW_MACADDR_MGT
  tristate "Allwinner Network MAC Addess Manager"
  depends on AW_RFKILL || BT || ETHERNET
  help
    allwinner network mac address management
```

## zhiyuan/kernel/driver/drivers/net/Kconfig
```kconfig
menu "Network Device Drivers"
	depends on NET

if NETDEVICES

source "$(BSP_TOP)drivers/net/wireless/Kconfig"

endif

endmenu
```

## zhiyuan/kernel/driver/drivers/net/wireless/Kconfig
```kconfig
menu "Wireless LAN"
	depends on !S390
	depends on NET

if WLAN

source "$(BSP_TOP)drivers/net/wireless/bcmdhd/Kconfig"
source "$(BSP_TOP)drivers/net/wireless/xr829/Kconfig"

endif

endmenu
```

## zhiyuan/kernel/driver/drivers/pinctrl/Kconfig
```kconfig
# SPDX-License-Identifier: GPL-2.0-only
menu "Pinctrl Drivers"
	depends on AW_BSP

config AW_PINCTRL
	tristate "Pinctrl Support for Allwinner SoCs"
	depends on AW_BSP
	select PINMUX
	select GENERIC_PINCONF
	select GPIOLIB
	default y

config AW_PINCTRL_DEBUGFS
	tristate "Pinctrl Debugfs Driver"
	depends on AW_PINCTRL && DEBUG_FS
	default n

config AW_PINCTRL_SUN8IW15P1
	tristate "SUN8IW15P1 PIO"
	depends on AW_PINCTRL
	default ARCH_SUN8IW15

config AW_PINCTRL_SUN8IW15P1_R
	tristate "SUN8IW15P1 R_PIO"
	depends on AW_PINCTRL
	default ARCH_SUN8IW15

config AW_PINCTRL_SUN8IW20
	tristate "SUN8IW20 PIO"
	depends on AW_PINCTRL
	default ARCH_SUN8IW20 || ARCH_SUN20IW1

config AW_PINCTRL_SUN50IW9
	tristate "SUN50IW9 PIO"
	depends on AW_PINCTRL
	default ARCH_SUN50IW9

config AW_PINCTRL_SUN50IW9_R
	tristate "SUN50IW9 R_PIO"
	depends on AW_PINCTRL
	default ARCH_SUN50IW9

config AW_PINCTRL_SUN50IW10P1
	tristate "SUN50IW10P1 PIO"
	depends on AW_PINCTRL
	default ARCH_SUN50IW10

config AW_PINCTRL_SUN50IW10P1_R
	tristate "SUN50IW10P1 R_PIO"
	depends on AW_PINCTRL
	default ARCH_SUN50IW10

config AW_PINCTRL_SUN50IW12
	tristate "SUN50IW12 PIO"
	depends on AW_PINCTRL
	default ARCH_SUN50IW12

config AW_PINCTRL_SUN50IW12_R
	tristate "SUN50IW12 R_PIO"
	depends on AW_PINCTRL
	default ARCH_SUN50IW12

endmenu
```

## zhiyuan/kernel/driver/drivers/timer/Kconfig
```kconfig
# SPDX-License-Identifier: GPL-2.0-only
menu "Timer Drivers"
	depends on GENERIC_CLOCKEVENTS
	depends on AW_BSP

config AW_TIMER
	tristate "Timer support for Allwinner SoCs"
	depends on HAS_IOMEM
	select CLKSRC_MMIO
	select TIMER_OF
	help
	  Enables support for the Sun4i timer.

endmenu
```

## zhiyuan/kernel/driver/drivers/usb/Kconfig
```kconfig
# SPDX-License-Identifier: GPL-2.0
#
# USB configuration
#

if AW_BSP && USB_SUPPORT

if USB

source "$(BSP_TOP)drivers/usb/host/Kconfig"

endif # USB

source "$(BSP_TOP)drivers/usb/sunxi_usb/Kconfig"

endif # USB_SUPPORT
```

## zhiyuan/kernel/driver/platform/Kconfig
```kconfig
# SPDX-License-Identifier: GPL-2.0-only

menu "Platform Selection"

config AW_BSP
	bool "Allwinner Platform"
	select ARCH_SUNXI
	select ARCH_HAS_RESET_CONTROLLER
	select GENERIC_IRQ_CHIP
	select PINCTRL
	select RESET_CONTROLLER
	help
	  This enables support for Allwinner sunxi based SoCs like the A64.

choice
	prompt "Select SoC Family"
	default ARCH_SUN8I  if ARM
	default ARCH_SUN50I if ARM64
	default ARCH_SUN20I if RISCV
	depends on AW_BSP
	help
	  Select the Family for SoC

config ARCH_SUN8I
	bool "Allwinner SUN8I"
	depends on AW_BSP && ARM
	help
	  Allwinner SUN8I SoC Family

config ARCH_SUN50I
	bool "Allwinner SUN50I"
	depends on AW_BSP
	#select xxx if ARM
	#select xxx64 if ARM64
	help
	  Allwinner SUN50I SoC Family

config ARCH_SUN55I
	bool "Allwinner SUN55I"
	depends on AW_BSP && ARM64
	help
	  Allwinner SUN55I SoC Family

config ARCH_SUN20I
	bool "Allwinner SUN20I"
	depends on AW_BSP && RISCV
	help
	  Allwinner SUN20I SoC Family

endchoice

choice
	prompt "Select the Wafer"
	default ARCH_SUN50IW10
	depends on AW_BSP
	help
	  Select the wafer

config ARCH_SUN50IW9
	bool "SUN50IW9"
	depends on ARCH_SUN50I
	help
	  Support for Allwinner SUN50IW9 SoC

config ARCH_SUN50IW10
	bool "SUN50IW10"
	depends on ARCH_SUN50I
	help
	  Support for Allwinner SUN50IW10 SoC

config ARCH_SUN50IW12
	bool "SUN50IW12"
	depends on ARCH_SUN50I
	help
	  Support for Allwinner SUN50IW12 SoC

endchoice

#choice
#	prompt "Select the SoC"
#	help
#	  Select the SoC
#
#config ARCH_SUN50IW10P1
#	depends on ARCH_SUN50IW10
#	bool "Allwinner SUN50IW10P1"
#	select SUNXI_SMC  # SUNXI_SMC is not used in FPGA stage
#endchoice

choice
	prompt "Select the Board"
	depends on AW_BSP
	default AW_FPGA_S4

config AW_FPGA_S4
	bool "FPGA S4 Board"
	help
	  Support for Allwinner FPGA S4 board

config AW_FPGA_V7
	bool "FPGA V7 Board"
	help
	  Support for Allwinner FPGA V7 board

config AW_IC_BOARD
	bool "IC Board"
	help
	  Support for Allwinner IC board
endchoice

config AW_SOC_NAME
	string "SoC Name"
	default ""
	depends on AW_BSP
	help
	  Used by sysfs: /sys/.../sysinfo

endmenu
```
